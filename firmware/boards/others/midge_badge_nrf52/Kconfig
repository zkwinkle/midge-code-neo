## firmware/boards/others/midge_badge_nrf52/Kconfig.defconfig
```kconfig
if BOARD_MIDGE_BADGE_NRF52

config HW_STACK_PROTECTION
	default ARCH_HAS_STACK_PROTECTION

endif
```

## firmware/boards/others/midge_badge_nrf52/board.yml
```yaml
board:
  name: midge_badge_nrf52
  full_name: SPCL Midge Badge
  vendor: others
  socs:
    - name: nrf52832
```
