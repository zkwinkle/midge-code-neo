## CMakeLists.txt
```
cmake_minimum_required(VERSION 3.20.0)

find_package(Zephyr REQUIRED HINTS $ENV{ZEPHYR_BASE})

project(blinky)

# Get the current git commit hash
execute_process(
    COMMAND uv run hatch version
    WORKING_DIRECTORY ${CMAKE_CURRENT_SOURCE_DIR}
    OUTPUT_VARIABLE HATCH_VERSION
    OUTPUT_STRIP_TRAILING_WHITESPACE
    ERROR_QUIET
)

# Add the commit hash as a compile definition
add_compile_definitions(FW_VERSION="${HATCH_VERSION}")

add_subdirectory(src/imu_drivers)

target_sources(app PRIVATE
    src/main.c
    src/storage.c
    src/proximity.c
    src/audio.c
    src/imu.c
    src/battery_charge.c
    src/time_control.c
    src/cmd_processor.c
    src/privacy_switch.c
    src/status_led.c
    )
```

## Kconfig
```
menu "midge-code-neo"

choice MIDGE_CODE_SEL_IMU
	prompt "IMU selection"
	default MIDGE_CODE_SEL_IMU_ICM20948

config MIDGE_CODE_SEL_IMU_ICM20948
	bool "ICM20948"

config MIDGE_CODE_SEL_IMU_ICM42605
	bool "ICM42605"

endchoice

config MIDGE_CODE_IMU_ICM20948_USE_CLOSED_DRIVER
	bool "Use closed-source driver for ICM20948"
	depends on MIDGE_CODE_SEL_IMU_ICM20948
	default y
	help
	  Enable to use the closed-source ICM20948 driver.
	  Disable to use the Zephyr native ICM20948 driver.

endmenu

source "Kconfig.zephyr"
```

## prj.conf
```kconfig
# APPLICATION CONFIGURATION
CONFIG_MIDGE_CODE_IMU_ICM20948_USE_CLOSED_DRIVER=y


# General
CONFIG_STD_C23=y
CONFIG_GNU_C_EXTENSIONS=y
CONFIG_PRINTK=y
CONFIG_LOG=y
CONFIG_MAIN_STACK_SIZE=2048
CONFIG_OUTPUT_DISASSEMBLY=y
CONFIG_DEBUG=y
CONFIG_DEBUG_OPTIMIZATIONS=n
#CONFIG_MISRA_SANE=y
#CONFIG_CODING_GUIDELINE_CHECK=y
#CONFIG_COMPILER_WARNINGS_AS_ERRORS=y

# Bluetooth
CONFIG_BT=y
CONFIG_BT_PERIPHERAL=y
CONFIG_BT_ZEPHYR_NUS=y
CONFIG_BT_OBSERVER=y
CONFIG_BT_DEVICE_NAME="MidgeBadge"
CONFIG_BT_MAX_CONN=1

# IMU
CONFIG_I2C=y
CONFIG_GPIO_ENABLE_DISABLE_INTERRUPT=y

# Audio
CONFIG_AUDIO=y
CONFIG_AUDIO_DMIC=y

# Battery charge
CONFIG_GPIO=y
CONFIG_ADC=y

# SDMMC
CONFIG_DISK_ACCESS=y
CONFIG_FILE_SYSTEM=y
CONFIG_FAT_FILESYSTEM_ELM=y
# need to add to doc
CONFIG_FS_FATFS_REENTRANT=y
CONFIG_FILE_SYSTEM_MKFS=y
CONFIG_FS_FATFS_NUM_FILES=7

# Mover a un overlay de conf (?)
CONFIG_DISK_DRIVER_SDMMC=y
CONFIG_SPI=y
CONFIG_BOOTLOADER_MCUBOOT=n

#CONFIG_TIMESLICE_SIZE=5
CONFIG_TIMESLICING=y
CONFIG_MAIN_THREAD_PRIORITY=0
#CONFIG_SCHED_SIMPLE=y

# callbacks command
CONFIG_BT_RX_STACK_SIZE=2048
CONFIG_SYSTEM_WORKQUEUE_STACK_SIZE=2048
```

## src/main.c
```c
#include <zephyr/device.h>
#include <zephyr/kernel.h>
#include <zephyr/logging/log.h>
#include <zephyr/sys/util.h>

#include "audio.h"
#include "imu.h"
#include "battery_charge.h"
#include "cmd_processor.h"
#include "privacy_switch.h"
#include "proximity.h"
#include "status_led.h"
#include "storage.h"
#include "time_control.h"

LOG_MODULE_REGISTER(main_module);
struct init_item {
    int (*fn)(void);
    const char* name;
};

static int run_inits(const struct init_item* items, size_t n) {
    int ret = 0;
    for (size_t i = 0; i < n; i++) {
        ret = items[i].fn();
        if (ret < 0) {
            LOG_ERR("Failed to initialize %s", items[i].name);
            break;
        }
    }
    led_report_status(ret);
    return ret;
}

 int main() {
    int ret = led_init();
    if (ret < 0) {
        LOG_ERR("Failed to initialize LED");
        return ret;
    }

    const struct init_item inits[] = {
        {storage_init_fs, "storage"},
        {battery_charge_init,  "battery charge sensor"},
        {audio_sensor_init,  "audio sensor"},
        {switch_sensor_init,  "switch sensor"},
        {proximity_sensor_init,  "proximity sensor"},
        {imu_sensor_init,  "IMU sensor"},
        {cmd_processor_init,  "command processor"},
    };



    ret =  run_inits(inits, ARRAY_SIZE(inits));

    /*audio_sensor_start(2, 1);
    k_sleep(K_SECONDS(60*3));
    audio_sensor_stop();*/
    led_report_active(false);
    return ret;
}
```

## src/audio.c
```c
#include "audio.h"

#include <stdbool.h>
#include <string.h>
#include <zephyr/audio/dmic.h>
#include <zephyr/kernel.h>
#include <zephyr/logging/log.h>

#include "midge_protocol.h"
#include "privacy_switch.h"
#include "storage.h"
#include "time_control.h"

LOG_MODULE_REGISTER(mb_audio);

#define MAX_SAMPLE_RATE 20000

#define SAMPLE_BIT_WIDTH 16
#define BYTES_PER_SAMPLE sizeof(int16_t)

/* Size of a block for 100 ms of audio data. */
#define BLOCK_SIZE(_sample_rate, _number_of_channels) \
    (BYTES_PER_SAMPLE * (_sample_rate / 10) * _number_of_channels)

/* Driver will allocate blocks from this slab to receive audio data into them.
 * Application, after getting a given block from the driver and processing its
 * data, needs to free that block.
 */
#define MAX_BLOCK_SIZE 4096  //(BLOCK_SIZE(MAX_SAMPLE_RATE, 2)) / 2
#define BLOCK_COUNT 5

struct k_mem_slab mem_slab;
char mem_slab_buffer[BLOCK_COUNT*MAX_BLOCK_SIZE] __aligned(4);

//K_MEM_SLAB_DEFINE_STATIC(mem_slab, MAX_BLOCK_SIZE, BLOCK_COUNT, 4);

#define HIGH_SAMPLE_RATE MAX_SAMPLE_RATE
#define LOW_SAMPLE_RATE_DECIMATION 16
#define LOW_SAMPLE_RATE (HIGH_SAMPLE_RATE / LOW_SAMPLE_RATE_DECIMATION)

const struct device* const dmic_dev = DEVICE_DT_GET(DT_NODELABEL(dmic_dev));
/**
 * @brief Microphone configuration. Depends on hardware. Might be useful to
 * have the config defined as part of the device tree
 * For now, assumes usage of PDM Mic ST MP34DT05TR-A
 */
struct pdm_io_cfg microphone_cfg = {
    .min_pdm_clk_freq = 1200000,
    .max_pdm_clk_freq = 3250000,
    // usual value in datasheets: 40% min, 60% max, 50% typical
    .min_pdm_clk_dc = 40,
    .max_pdm_clk_dc = 60,
};

struct pcm_stream_cfg stream = {
    .pcm_width = SAMPLE_BIT_WIDTH,
    .mem_slab = &mem_slab,
};

static struct {
    enum {
        AUDIO_SENSOR_STATE_DISABLED = 0,
        AUDIO_SENSOR_STATE_ACTIVE = 1,
        AUDIO_SENSOR_STATE_STOP = 2,
        AUDIO_SENSOR_STATE_ERR = 3,
    } state;
    struct dmic_cfg audio_config;
    uint16_t sample_iter;
} sensor_data = {.state = AUDIO_SENSOR_STATE_DISABLED, .sample_iter = 0, .audio_config = {}};

static int write_metadata(struct AudioMetaData* metadata) {
    char buffer[128];
    int len = snprintf(buffer, sizeof(buffer), "%" PRIu64 ", %d,%d,%d,%d\n", metadata->timestamp_ms,
                       metadata->status_code, metadata->event_type, metadata->frequency_hz,
                       metadata->num_channels);
    if (len < 0) {
        LOG_ERR("Failed to format audio metadata, status %d\n", len);
        return -EFAULT;
    }

    int ret = storage_write(FILE_TYPE_AUDIO_METADATA, buffer, len);
    if (ret < 0) {
        LOG_ERR("Failed to write audio metadata, status %d\n", ret);
        // not aborting on metadata write failure since the sample data will still
        // be written and the metadata is not critical, although it provides useful
        // context for the sample
    }
    return ret;
}

uint8_t audio_sensor_get_status() { return (uint8_t)sensor_data.state; }

struct AudioSamplingWorkCtx {
    struct k_work init_work;
    struct k_sem init_done;
    int init_ret;
    struct k_work_delayable process_work;
    struct k_sem stop_done;
    int stop_ret;
    int inter_sample_delay_ms;
} audio_sampling_work_ctx;

static void audio_sample_process_work_handler(struct k_work* work);

static void audio_init_sampling_work_handler(struct k_work* work) {
    struct AudioSamplingWorkCtx* ctx = CONTAINER_OF(work, struct AudioSamplingWorkCtx, init_work);
    int ret = 0;
    do {
        ret = storage_init_sample_file(FILE_TYPE_AUDIO, sensor_data.sample_iter);
        if (ret < 0) {
            LOG_ERR("Failed to open sampling file, status %d", ret);
            sensor_data.state = AUDIO_SENSOR_STATE_ERR;
            break;
        }

        ret = storage_init_sample_file(FILE_TYPE_AUDIO_METADATA, sensor_data.sample_iter);
        char csv_header[] = "timestamp(ms), status, event, freq, channels\n";
        if (ret == 0){
            ret = storage_write(FILE_TYPE_AUDIO_METADATA, csv_header, sizeof(csv_header));
        }
        if (ret < 0) {
            LOG_ERR("Failed to open metadata file, status %d", ret);
            sensor_data.state = AUDIO_SENSOR_STATE_ERR;
            storage_close(FILE_TYPE_AUDIO);
            break;
        }

        // trigger start
        ret = dmic_trigger(dmic_dev, DMIC_TRIGGER_START);
        if (ret < 0) {
            // error on trigger
            LOG_ERR("Failed to trigger start");
            sensor_data.state = AUDIO_SENSOR_STATE_ERR;
            storage_close(FILE_TYPE_AUDIO);
            storage_close(FILE_TYPE_AUDIO_METADATA);
            break;
        } else {
            struct AudioMetaData metadata = {
                .timestamp_ms = time_control_get_timestamp(),
                .status_code = 0,
                .event_type = AUDIO_EVENT_TYPE_TRIGGER_START,
                .frequency_hz = sensor_data.audio_config.streams->pcm_rate,
                .num_channels = sensor_data.audio_config.channel.act_num_chan,
            };
            write_metadata(&metadata);
        }

        // calculate the expected time between samples.
        ctx->inter_sample_delay_ms =
            (sensor_data.audio_config.streams->block_size * 1000) /
            (sensor_data.audio_config.streams->pcm_rate *
             sensor_data.audio_config.channel.act_num_chan * BYTES_PER_SAMPLE);

        // submit audio sample process to system queue
        LOG_INF("starting audio sampling");
        k_work_init_delayable(&ctx->process_work, audio_sample_process_work_handler);
        int ret = k_work_schedule(&ctx->process_work, K_MSEC(ctx->inter_sample_delay_ms));

        if (ret < 0) {
            LOG_ERR("Failed to schedule audio sample processing work, status %d", ret);
            sensor_data.state = AUDIO_SENSOR_STATE_ERR;
            dmic_trigger(dmic_dev, DMIC_TRIGGER_STOP);
            storage_close(FILE_TYPE_AUDIO);
            storage_close(FILE_TYPE_AUDIO_METADATA);
        } else {
            sensor_data.state = AUDIO_SENSOR_STATE_ACTIVE;
        }
    } while (0);
    if (ret < 0) {
    }

    ctx->init_ret = ret;
    k_sem_give(&ctx->init_done);
}

static void audio_sample_process_work_handler(struct k_work* work) {
    struct k_work_delayable* dwork = k_work_delayable_from_work(work);
    struct AudioSamplingWorkCtx* ctx =
        CONTAINER_OF(dwork, struct AudioSamplingWorkCtx, process_work);

    void* audio_buffer;
    uint32_t audio_buffer_size;
    int ret;
    if (sensor_data.state == AUDIO_SENSOR_STATE_ACTIVE) {
        // read buffer
        ret = dmic_read(dmic_dev, 0, &audio_buffer, &audio_buffer_size, ctx->inter_sample_delay_ms);
        if (ret < 0) {
            // error on trigger
            if (ret == -EBUSY || ret == -ENOMSG || ret == -EAGAIN) {
                LOG_INF("Sample read timeout reached, sample most likely dropped, retriggering\n");
                struct AudioMetaData metadata = {
                    .timestamp_ms = time_control_get_timestamp(),
                    .status_code = ret,
                    .event_type = AUDIO_EVENT_TYPE_TRIGGER_START,
                    .frequency_hz = sensor_data.audio_config.streams->pcm_rate,
                    .num_channels = sensor_data.audio_config.channel.act_num_chan,
                };
                // drop all buffer data and re-init sampling
                k_mem_slab_init(&mem_slab, mem_slab_buffer, MAX_BLOCK_SIZE, BLOCK_COUNT);
                int retry_status = dmic_trigger(dmic_dev, DMIC_TRIGGER_START);
                if (retry_status < 0) {
                    LOG_ERR(
                        "Failed to retrigger start after sample read timeout, status %d, "
                        "aborting\n",
                        retry_status);
                    sensor_data.state = AUDIO_SENSOR_STATE_ERR;
                } else {
                    ret = write_metadata(&metadata);
                }
                // timestamp should be added to metadata file to keep track of dropped samples
            } else {
                LOG_ERR("unknown read err %d\n, sample probably dropped, aborting", ret);
                sensor_data.state = AUDIO_SENSOR_STATE_ERR;
            }
        } else {
            ret = storage_write(FILE_TYPE_AUDIO, audio_buffer, audio_buffer_size);
            k_mem_slab_free(&mem_slab, audio_buffer);
            if (ret < 0) {
                LOG_ERR("write sample failed \n");
                // sampling will stop, file system could be compromised.
                sensor_data.state = AUDIO_SENSOR_STATE_ERR;
            }
        }
    }

    if (sensor_data.state == AUDIO_SENSOR_STATE_ACTIVE) {
        k_work_reschedule(&ctx->process_work, K_NO_WAIT);
    } else {
        // trigger stop
        ret = dmic_trigger(dmic_dev, DMIC_TRIGGER_STOP);
        if (ret < 0) {
            // error on trigger
            LOG_ERR("trigger stop failed, critical error\n");
            sensor_data.state = AUDIO_SENSOR_STATE_ERR;
        } else {
            struct AudioMetaData metadata = {
                .timestamp_ms = time_control_get_timestamp(),
                .status_code = ret,
                .event_type = AUDIO_EVENT_TYPE_TRIGGER_STOP,
                .frequency_hz = sensor_data.audio_config.streams->pcm_rate,
                .num_channels = sensor_data.audio_config.channel.act_num_chan,
            };
            ret = write_metadata(&metadata);

            sensor_data.state = AUDIO_SENSOR_STATE_STOP;
            LOG_INF("finished sampling round");
            ret = storage_close(FILE_TYPE_AUDIO);
            int ret2 = storage_close(FILE_TYPE_AUDIO_METADATA);
            if ((ret < 0) || (ret2 < 0)) {
                LOG_ERR("Failed to close files, status samples: %d  metadata: %d", ret, ret2);
                sensor_data.state = AUDIO_SENSOR_STATE_ERR;
                ret = (ret < 0) ? ret : ret2;  // return the error code of the first failure, if any
            }
        }
        ctx->stop_ret = ret;
        k_sem_give(&ctx->stop_done);
    }
}

int audio_sensor_start(int sample_iter, int mode) {
    // Get sampling freq based on switch position
    enum privacy_sw_pos switch_pos = switch_sensor_position();

    // configurar canales
    memset(&sensor_data.audio_config, 0,
           sizeof(struct dmic_cfg));  // clear configuration

    sensor_data.audio_config.channel.req_num_streams = 1;
    sensor_data.audio_config.io = microphone_cfg;

    sensor_data.audio_config.channel.req_num_chan = mode;
    switch (mode) {
        case AUDIO_MODE_MONO: {
            sensor_data.audio_config.channel.req_chan_map_lo =
                dmic_build_channel_map(0, 0, PDM_CHAN_LEFT);
        } break;
        case AUDIO_MODE_STEREO: {
            sensor_data.audio_config.channel.req_chan_map_lo =
                dmic_build_channel_map(0, 0, PDM_CHAN_LEFT) |
                dmic_build_channel_map(1, 0, PDM_CHAN_RIGHT);
        } break;
        default: {
            sensor_data.state = AUDIO_SENSOR_STATE_ERR;
            return -EINVAL;
        }
    }

    switch (switch_pos) {
        case PRIVACY_SWITCH_POS_LOW: {
            stream.pcm_rate = LOW_SAMPLE_RATE;
            stream.block_size = MAX_BLOCK_SIZE;  // BLOCK_SIZE(LOW_SAMPLE_RATE, mode);
        } break;
        case PRIVACY_SWITCH_POS_HIGH: {
            stream.pcm_rate = HIGH_SAMPLE_RATE;
            stream.block_size = MAX_BLOCK_SIZE;  // BLOCK_SIZE(HIGH_SAMPLE_RATE, 1);
        } break;
        case PRIVACY_SWITCH_POS_OFF:
        default: {
            sensor_data.state = AUDIO_SENSOR_STATE_DISABLED;
            return -EACCES;
        }
    }
    sensor_data.audio_config.streams = &stream;
    int ret = dmic_configure(dmic_dev, &sensor_data.audio_config);
    if (ret < 0) {
        LOG_ERR("DMIC configuration failed");
        return ret;
    }

    sensor_data.sample_iter = sample_iter;

    memset(&audio_sampling_work_ctx, 0, sizeof(audio_sampling_work_ctx));
    k_sem_init(&audio_sampling_work_ctx.init_done, 0, 1);
    k_sem_init(&audio_sampling_work_ctx.stop_done, 0, 1);

    k_work_init(&audio_sampling_work_ctx.init_work, audio_init_sampling_work_handler);
    int submit_ret = k_work_submit(&audio_sampling_work_ctx.init_work);

    if (submit_ret < 0) {
        LOG_ERR("Failed to submit audio sampling init work, status %d", submit_ret);
        ret = submit_ret;
    } else {
        k_sem_take(&audio_sampling_work_ctx.init_done, K_FOREVER);
        ret = audio_sampling_work_ctx.init_ret;
    }
    return ret;
}

int audio_sensor_stop() {
    int ret = 0;
    if (sensor_data.state != AUDIO_SENSOR_STATE_ACTIVE) {
        LOG_ERR("Invalid state to stop audio sampling, state %d", sensor_data.state);
        ret = -EPERM;
    } else {
        sensor_data.state = AUDIO_SENSOR_STATE_STOP;
        int ret = k_sem_take(&audio_sampling_work_ctx.stop_done, K_SECONDS(1));
        if (ret < 0) {
            LOG_ERR("Failed to take stop done semaphore, status %d, forcing work abort", ret);
            ret = k_work_cancel_delayable(&audio_sampling_work_ctx.process_work);
            sensor_data.state = AUDIO_SENSOR_STATE_ERR;
            if (ret < 0) {
                LOG_ERR("Failed to cancel audio processing work, status %d", ret);
            }
        } else {
            ret = audio_sampling_work_ctx.stop_ret;
        }
    }
    return ret;
}

int audio_sensor_init(void) {
    if (!device_is_ready(dmic_dev)) {
        LOG_ERR("%s is not ready", dmic_dev->name);
        sensor_data.state = AUDIO_SENSOR_STATE_ERR;
        return -1;
    }
    if(k_mem_slab_init(&mem_slab, mem_slab_buffer, MAX_BLOCK_SIZE, BLOCK_COUNT)){
        LOG_ERR("Failed to initialize memory slab for audio samples");
        sensor_data.state = AUDIO_SENSOR_STATE_ERR;
        return -1;
    }
    sensor_data.state = AUDIO_SENSOR_STATE_STOP;
    LOG_INF("init ok");
    return 0;
}

int cmd_mic_start(uint8_t* data) {
    struct CmdStartMicRequest* req_data = (struct CmdStartMicRequest*)data;
    int ret = audio_sensor_start(req_data->sample_id, req_data->mode);
    memset(data, 0, sizeof(struct CmdStartMicResponse));
    struct CmdStartMicResponse* resp_data = (struct CmdStartMicResponse*)data;
    resp_data->status_code = ret;
    return ret;
}

int cmd_mic_stop(uint8_t* data) {
    // struct CmdStartMicRequest* req_data = (struct CmdStartMicRequest*)data;
    struct CmdStartMicResponse* resp_data = (struct CmdStartMicResponse*)data;
    int ret = audio_sensor_stop();
    resp_data->status_code = ret;
    return ret;
}
```

## src/audio.h
```c
#ifndef MB_AUDIO_H
#define MB_AUDIO_H

#include <inttypes.h>

uint8_t audio_sensor_get_status();

int audio_sensor_init();

enum audio_mode {
    AUDIO_MODE_MONO = 1,
    AUDIO_MODE_STEREO = 2,
};

struct AudioMetaData {
    uint64_t timestamp_ms;
    int status_code;
    enum {
        /// Multiple trigger start entries would mean samples were dropped, the timestamp provides
        /// an approximate reference to the timing of the dropped sample(s) although it is not exact
        AUDIO_EVENT_TYPE_TRIGGER_START = 0,
        AUDIO_EVENT_TYPE_TRIGGER_STOP = 1
    } event_type;
    uint16_t frequency_hz; // only used for trigger start events to indicate the sampling frequency of the recorded samples
    uint8_t num_channels;
};


// int proximity_sensor_change_config(uint16_t interval, uint16_t window);

int audio_sensor_start(int sample_iter, int mode);

int audio_sensor_stop();

int cmd_mic_start(uint8_t* data);
int cmd_mic_stop(uint8_t* data);

#endif
```

## src/battery_charge.c
```c
#include "battery_charge.h"

#include <zephyr/drivers/adc.h>
#include <zephyr/kernel.h>
#include <zephyr/logging/log.h>

LOG_MODULE_REGISTER(mb_battery);

#define VOLTAGE_DIVIDER_RATIO 2

static const struct adc_dt_spec adc_channel = ADC_DT_SPEC_GET(DT_PATH(zephyr_user));
static int32_t buf = 0;

static struct adc_sequence sequence = {
    .buffer = &buf,
    /* buffer size in bytes, not number of samples */
    .buffer_size = sizeof(int32_t),
    // Optional
    //.calibrate = true,
};

int battery_charge_init() {
    int ret;
    if (!adc_is_ready_dt(&adc_channel)) {
        LOG_ERR("ADC %s not ready", adc_channel.dev->name);
        return 0;
    }
    ret = adc_channel_setup_dt(&adc_channel);
    if (ret < 0) {
        LOG_ERR("Could not setup channel #%d", ret);
        return 0;
    }

    ret = adc_sequence_init_dt(&adc_channel, &sequence);
    if (ret < 0) {
        LOG_ERR("Could not initalize sequence");
    }
    LOG_INF("init OK");
    return ret;
}

int battery_charge_get_mv(int16_t* val_mv) {
    int ret;

    ret = adc_read(adc_channel.dev, &sequence);
    if (ret < 0) {
        LOG_ERR("Could not read (%d)", ret);
        return ret;
    }
    int32_t mv = buf;
    ret = adc_raw_to_millivolts_dt(&adc_channel, &mv);
    /* conversion to mV may not be supported, skip if not */
    if (ret < 0) {
        LOG_ERR(" (value in mV not available)");
    } else {
        // safe cast to cast to int16_t as battery voltage can be expected to be
        // below ~4200mV as it is a LiPO battery
        *val_mv = (int16_t)(mv * VOLTAGE_DIVIDER_RATIO);
        LOG_DBG("val = %d mV  buf: %d", *val_mv, buf);
    }
    return ret;
}
```

## src/battery_charge.h
```c
#ifndef MB_BATTERY_CHARGE_H
#define MB_BATTERY_CHARGE_H

#include <inttypes.h>


int battery_charge_init();

int battery_charge_get_mv(int16_t* val_mv);

#endif
```

## src/cmd_processor.c
```c
#include "cmd_processor.h"

#include <inttypes.h>
#include <stdbool.h>
#include <stddef.h>
#include <string.h>
#include <zephyr/bluetooth/bluetooth.h>
#include <zephyr/bluetooth/services/nus.h>
#include <zephyr/kernel.h>
#include <zephyr/logging/log.h>
#include <zephyr/sys/util.h>

#include "audio.h"
#include "battery_charge.h"
#include "imu.h"
#include "midge_protocol.h"
#include "proximity.h"
#include "storage.h"
#include "time_control.h"

LOG_MODULE_REGISTER(cmd_processor);

struct CustomAdvertisementData advertised_data = {
    .battery_mv = 0,
    .active_sensor_bitflags = 0,
    .badge_assignment = {.u16_all = 0xFFFF}
};

int cmd_setup_experiment(uint8_t* data) {
    struct CmdSetupExperimentRequest* req_data = (struct CmdSetupExperimentRequest*)data;
    struct CmdSetupExperimentResponse* resp_data = (struct CmdSetupExperimentResponse*)data;

    advertised_data.badge_assignment = req_data->badge_assignment;
    int ret = storage_init_experiment(req_data->experiment_id);

    resp_data->status_code = ret;
    return ret;
}

int cmd_status(uint8_t* data) {
    LOG_INF("received status message");
    struct CmdStatusRequest* req_data = (struct CmdStatusRequest*)data;

    uint64_t current_interpolation = time_control_get_timestamp();
    uint64_t delta = current_interpolation > req_data->millis_since_epoch
                         ? current_interpolation - req_data->millis_since_epoch
                         : req_data->millis_since_epoch - current_interpolation;

    int ret = time_control_update(req_data->millis_since_epoch);
    if(ret < 0){
        LOG_ERR("Failed to perform the time sync");
    }

    int16_t mv = 0;
    ret = battery_charge_get_mv(&mv);
    if (ret < 0) {
        LOG_ERR("Failed to read battery voltage");
    }

    struct CmdStatusResponse* resp_data = (struct CmdStatusResponse*)data;
    memset(resp_data, 0, sizeof(struct CmdStatusResponse));
    resp_data->badge_assignment = advertised_data.badge_assignment;
    resp_data->sync_status = 0;
    resp_data->sync_delta_ms = delta;
    resp_data->audio_init_status = audio_sensor_get_status();
    LOG_INF("audio sensor get status");
    resp_data->battery_millivolts = mv;
    resp_data->proximity_init_status = proximity_sensor_get_status();
    LOG_INF("proximity sensor get status");
    resp_data->storage_init_status = storage_get_status();
    LOG_INF("returning status");
    return ret;
}

int cmd_get_fw_version(uint8_t* data) {
    //struct CmdGetFWVersionRequest* req_data = (struct CmdGetFWVersionRequest*)data;
    struct CmdGetFWVersionResponse* resp_data = (struct CmdGetFWVersionResponse*)data;
    LOG_INF("received get fw version message");
    memset(resp_data, 0, sizeof(struct CmdGetFWVersionResponse));
    strcpy((char*)resp_data->version_str, FW_VERSION);
    LOG_INF("returning fw version: %s", resp_data->version_str);
    return 0;
}


int cmd_erase_sd(uint8_t* data) {
    // struct CmdEraseSDRequest* req_data = (struct CmdEraseSDRequest*)data;
    struct CmdEraseSDResponse* resp_data = (struct CmdEraseSDResponse*)data;
    int ret = storage_erase(DISK_MOUNT_POINT);
    resp_data->status_code = ret;
    return ret;
}

enum cmd_state { READ_SOT, READ_CMD, READ_DATA, READ_EOT };

struct cmd_processor_lut_entry {
    uint8_t cmd_id;
    int req_data_size;
    int resp_data_size;
    int (*execute_cmd)(uint8_t* data);
};

struct cmd_processor_lut_entry commands[] = {
    {'A', sizeof(struct CmdSetupExperimentRequest), sizeof(struct CmdSetupExperimentResponse), cmd_setup_experiment},
    {'B', sizeof(struct CmdStatusRequest), sizeof(struct CmdStatusResponse), cmd_status},
    {'C', sizeof(struct CmdGetFWVersionRequest), sizeof(struct CmdGetFWVersionResponse), cmd_get_fw_version},
    {'D', sizeof(struct CmdStartMicRequest), sizeof(struct CmdStartMicResponse), cmd_mic_start},
    {'E', sizeof(struct CmdStopMicRequest), sizeof(struct CmdStopMicResponse), cmd_mic_stop},
    {'F', sizeof(struct CmdStartScanRequest), sizeof(struct CmdStartScanResponse), cmd_scan_start},
    {'G', sizeof(struct CmdStopScanRequest), sizeof(struct CmdStopScanResponse), cmd_scan_stop},
    {'H', sizeof(struct CmdEraseSDRequest), sizeof(struct CmdEraseSDResponse), cmd_erase_sd},
    {'I', sizeof(struct CmdStartIMURequest), sizeof(struct CmdStartIMUResponse), cmd_start_imu},
    {'J', sizeof(struct CmdStopIMURequest), sizeof(struct CmdStopIMUResponse), cmd_stop_imu}};
    // get SD space command missing
    // file transfer commands missing


#define COMMAND_COUNT sizeof(commands)
#define MAX_CMD_DATA_SZ 128

int invalid_cmd(uint8_t* data) {
    printf("ERROR IN CMD PROCESSOR CONTROL FLOW");
    return -EINVAL;
}

static void received(struct bt_conn* conn, const void* data, uint16_t len, void* ctx) {
    static enum cmd_state rx_cmd_state = READ_SOT;
    // SOT + CMD_ID + DATA + EOT
    static uint8_t cmd_data[MAX_CMD_DATA_SZ];
    static int cmd_data_idx = 0;                      // currently read data
    static int cmd_req_data_size = 0;                 // how much data to read
    static int cmd_resp_data_size = 0;                // how much data to send
    int (*execute_cmd)(uint8_t* data) = invalid_cmd;  // ptr to command function

    // Get the negotiated MTU for the connection to determine how much data we
    // can send in one chunk
    int mtu = bt_gatt_get_mtu(conn) - 3; // Subtract ATT header size
    ARG_UNUSED(ctx);
    printk("%s() - Len: %d, Message: %.*s\n", __func__, len, len, (char*)data);
    const uint8_t* rx_data = (const uint8_t*)data;

    // State Machine
    for (int i = 0; i < len; i++) {
        uint8_t c = rx_data[i];

        switch (rx_cmd_state) {
            case READ_SOT:
                if (c == CMD_PROCESSOR_SOT) {
                    rx_cmd_state = READ_CMD;
                    cmd_data[0] = c;
                }
                break;
            case READ_CMD:
                bool cmd_is_valid = false;
                for (int j = 0; j < COMMAND_COUNT; j++) {
                    if (c == commands[j].cmd_id) {
                        execute_cmd = commands[j].execute_cmd;
                        cmd_req_data_size = commands[j].req_data_size + 2;
                        cmd_resp_data_size = commands[j].resp_data_size + 2;
                        cmd_data[1] = c;
                        cmd_data_idx = 2;
                        rx_cmd_state = READ_DATA;
                        cmd_is_valid = true;
                        break;
                    }
                }

                if (!cmd_is_valid) {
                    // invalid command, go back to read SOT
                    rx_cmd_state = READ_SOT;
                }

                break;
            case READ_DATA:
                cmd_data[cmd_data_idx] = c;
                cmd_data_idx++;
                if (cmd_data_idx < cmd_req_data_size) {
                    // keep reading

                } else {
                    // already read all data
                    rx_cmd_state = READ_EOT;
                }
                break;
            case READ_EOT:
                if (c == CMD_PROCESSOR_EOT) {
                    // valid termination
                    execute_cmd(&cmd_data[2]);
                    cmd_data[cmd_resp_data_size] = CMD_PROCESSOR_EOT;
                    // total message size: resp data (includes EOT and cmd_id) + SOT

                    //bt_nus_send(conn, cmd_data, cmd_resp_data_size + 1);

                    //Send data in chunks of 20 bytes
                    int total_bytes = cmd_resp_data_size + 1;
                    int bytes_sent = 0;
                    while (bytes_sent < total_bytes) {
                        int chunk_size = (total_bytes - bytes_sent) > mtu ? mtu : (total_bytes - bytes_sent);
                        int chunk_stat = bt_nus_send(conn, (void*)&cmd_data[bytes_sent], chunk_size);
                        if (chunk_stat  == -ENOMEM || chunk_stat == -EAGAIN) {
                            k_msleep(1);
                            continue;
                        } else if (chunk_stat < 0) {
                            LOG_ERR("Failed to send data over BLE: %d", chunk_stat);
                            break;
                        }
                        bytes_sent += chunk_size;
                    }
                } else {
                    // invalid termination
                }
                rx_cmd_state = READ_SOT;
                break;
            default:
                rx_cmd_state = READ_SOT;
        }
    }
}

/// =========================================
/// BLE
/// =========================================

#define DEVICE_NAME CONFIG_BT_DEVICE_NAME
#define DEVICE_NAME_LEN (sizeof(DEVICE_NAME) - 1)

static struct bt_data ad[] = {
    BT_DATA_BYTES(BT_DATA_FLAGS, (BT_LE_AD_GENERAL | BT_LE_AD_NO_BREDR)),
    BT_DATA(BT_DATA_NAME_COMPLETE, DEVICE_NAME, DEVICE_NAME_LEN),
    BT_DATA(BT_DATA_MANUFACTURER_DATA, (const uint8_t*)&advertised_data, sizeof(advertised_data)),
};

static struct bt_data sd[] = {
    BT_DATA_BYTES(BT_DATA_UUID128_ALL, BT_UUID_NUS_SRV_VAL),
};

#define ADVERTISED_DATA_THREAD_STACK_SIZE 512
#define ADVERTISED_DATA_THREAD_PRIORITY K_LOWEST_APPLICATION_THREAD_PRIO

K_THREAD_STACK_DEFINE(advertised_data_thread_stack, ADVERTISED_DATA_THREAD_STACK_SIZE);
static struct k_thread advertised_data_thread_data;

static void adv_data_update(void)
{
    int16_t mv = 0;
    if (battery_charge_get_mv(&mv) == 0) {
        advertised_data.battery_mv = (uint16_t)mv;
    }
    advertised_data.active_sensor_bitflags = storage_get_active_sensor_bitflags();
    bt_le_adv_update_data(ad, ARRAY_SIZE(ad), sd, ARRAY_SIZE(sd));
}

static void advertised_data_thread(void *arg1, void *arg2, void *arg3)
{
    ARG_UNUSED(arg1);
    ARG_UNUSED(arg2);
    ARG_UNUSED(arg3);

    while (true) {
        adv_data_update();
        k_sleep(K_SECONDS(1));
    }
}

static void notif_enabled(bool enabled, void* ctx) {
    ARG_UNUSED(ctx);
    printk("%s() - %s\n", __func__, (enabled ? "Enabled" : "Disabled"));
}

struct bt_nus_cb nus_listener = {
    .notif_enabled = notif_enabled,
    .received = received,
};


static void ble_conn_recycled_cb(){
    // move to work queue
    int err = bt_le_adv_start(BT_LE_ADV_CONN_FAST_1, ad, ARRAY_SIZE(ad), sd, ARRAY_SIZE(sd));
    if (err) {
        LOG_ERR("Failed to re-start advertising: %d", err);
    }
}

static void ble_conn_disconnected_cb(struct bt_conn* conn, uint8_t err){
    (void)err;
    (void)conn;
    err = bt_le_adv_stop(); // stop non connectable advertising
    if (err) {
        LOG_ERR("Connection failure %d", err);
    }
}

static void ble_conn_connected_cb(struct bt_conn* conn, uint8_t err){
    (void)err;
    (void)conn;
    // start non connectable advertising to allow scanning
    err = bt_le_adv_start(BT_LE_ADV_NCONN_IDENTITY, ad, ARRAY_SIZE(ad), sd, ARRAY_SIZE(sd));
    if (err) {
        LOG_ERR("Connection failure %d", err);
    }
}

struct bt_conn_cb conn_cb = {
    .recycled = ble_conn_recycled_cb,
    .disconnected = ble_conn_disconnected_cb,
    .connected = ble_conn_connected_cb
};

int cmd_processor_init(void) {
    int err;
    err = bt_nus_cb_register(&nus_listener, NULL);
    if (err) {
        LOG_ERR("Failed to register NUS callback: %d", err);
        return err;
    }
    err = bt_enable(NULL);
    if (err) {
        LOG_ERR("Failed to enable bluetooth: %d", err);
        return err;
    }
    bt_conn_cb_register(&conn_cb);

    err = bt_le_adv_start(BT_LE_ADV_CONN_FAST_1, ad, ARRAY_SIZE(ad), sd, ARRAY_SIZE(sd));
    if (err) {
        LOG_ERR("Failed to start advertising: %d", err);
        return err;
    }

        k_thread_create(&advertised_data_thread_data,
                        advertised_data_thread_stack,
                        K_THREAD_STACK_SIZEOF(advertised_data_thread_stack),
                        advertised_data_thread,
                        NULL,
                        NULL,
                        NULL,
                        ADVERTISED_DATA_THREAD_PRIORITY,
                        0,
                        K_SECONDS(2));
    LOG_INF("Initialization complete");
    return 0;
}
```

## src/cmd_processor.h
```c
#ifndef MB_CMD_PROCESSOR_H
#define MB_CMD_PROCESSOR_H

int cmd_processor_init();

#define CMD_PROCESSOR_SOT '#'
#define CMD_PROCESSOR_EOT '!'

#endif
```

## src/imu.c
```c
#include "imu.h"

#include <errno.h>
#include <zephyr/kernel.h>
#include <zephyr/logging/log.h>
#include <zephyr/sys/util.h>

#include "midge_protocol.h"
#include "storage.h"
#include "utility.h"

#if CONFIG_MIDGE_CODE_IMU_ICM20948_USE_CLOSED_DRIVER
#include "ICM20948_driver_interface.h"
#else
#error "No IMU driver defined"
#endif


LOG_MODULE_REGISTER(imu);

uint8_t imu_sensor_get_status() { return 0; }

int imu_sensor_init() { return icm20948_init(); }

int imu_sensor_start(int sample_iter, uint16_t acc_fsr, uint16_t gyr_fsr, uint16_t datarate) {
    // start imu files
    int accel_ret = storage_init_sample_file(FILE_TYPE_ACCEL, sample_iter);
    int gyro_ret = storage_init_sample_file(FILE_TYPE_GYRO, sample_iter);
    int magneto_ret = storage_init_sample_file(FILE_TYPE_MAGNETO, sample_iter);
    int rot_ret = storage_init_sample_file(FILE_TYPE_ROTATION, sample_iter);
    int stat = (accel_ret != 0) || (gyro_ret != 0) || (magneto_ret != 0) || (rot_ret != 0);
    if (stat) {
        LOG_ERR("Error initializing IMU sample files acc: %d - gyro: %d - magneto: %d - rot: %d",
                accel_ret, gyro_ret, magneto_ret, rot_ret);
        if (accel_ret == 0) {
            storage_close(FILE_TYPE_ACCEL);
        }
        if (gyro_ret == 0) {
            storage_close(FILE_TYPE_GYRO);
        }
        if (magneto_ret == 0) {
            storage_close(FILE_TYPE_MAGNETO);
        }
        if (rot_ret == 0) {
            storage_close(FILE_TYPE_ROTATION);
        }
        return -EAGAIN;
    }
    // start sensors
    int ret = icm20948_set_fsr((uint32_t)acc_fsr, (uint32_t)gyr_fsr);
    if (ret != 0) {
        return ret;
    }

    ret = icm20948_set_datarate(datarate);
    if (ret != 0) {
        return ret;
    }

    return icm20948_enable_sensors();
}

int imu_sensor_stop() {
    // stop sensors
    int ret = icm20948_disable_sensors();
    // close imu files
    if (ret == 0) {
        storage_close(FILE_TYPE_ACCEL);
        storage_close(FILE_TYPE_GYRO);
        storage_close(FILE_TYPE_MAGNETO);
        storage_close(FILE_TYPE_ROTATION);
    }
    return ret;
}

struct StartImuWorkCtx {
    struct k_work work;
    struct k_sem done;
    uint16_t sample_id;
    uint16_t acc_fsr;
    uint16_t gyr_fsr;
    uint16_t datarate;
    int ret;
};

static void start_imu_work_handler(struct k_work* work) {
    struct StartImuWorkCtx* ctx = CONTAINER_OF(work, struct StartImuWorkCtx, work);
    ctx->ret = imu_sensor_start(ctx->sample_id, ctx->acc_fsr, ctx->gyr_fsr, ctx->datarate);
    k_sem_give(&ctx->done);
}

int cmd_start_imu(uint8_t* data) {
    struct CmdStartIMURequest* req_data = (struct CmdStartIMURequest*)data;
    struct StartImuWorkCtx ctx = {.sample_id = req_data->sample_id,
                                  .acc_fsr = req_data->acc_fsr,
                                  .gyr_fsr = req_data->gyr_fsr,
                                  .datarate = req_data->datarate};
    k_sem_init(&ctx.done, 0, 1);
    k_work_init(&ctx.work, start_imu_work_handler);
    int ret = k_work_submit(&ctx.work);
    if (ret < 0) {
        LOG_ERR("Failed to submit start imu work: %d", ret);
    } else {
        ret = k_sem_take(&ctx.done, K_FOREVER);
        if (ret != 0) {
            LOG_ERR("Failed to take semaphore for start imu work: %d", ret);
        } else {
            ret = ctx.ret;
        }
    }

    struct CmdStartIMUResponse* resp_data = (struct CmdStartIMUResponse*)data;
    memset(resp_data, 0, sizeof(struct CmdStartIMUResponse));
    resp_data->status_code = ret;
    return ret;
}

static void stop_imu_work_handler(struct k_work* work) {
    struct SimpleWorkCtx* ctx = CONTAINER_OF(work, struct SimpleWorkCtx, work);
    ctx->ret = imu_sensor_stop();
    k_sem_give(&ctx->done);
}

int cmd_stop_imu(uint8_t* data) {
    // struct CmdStopIMURequest* req_data = (struct CmdStopIMURequest*)data;
    struct CmdStopIMUResponse* resp_data = (struct CmdStopIMUResponse*)data;
    struct SimpleWorkCtx ctx;
    k_work_init(&ctx.work, stop_imu_work_handler);
    k_sem_init(&ctx.done, 0, 1);

    int ret;
    int submit_ret = k_work_submit(&ctx.work);
    if (submit_ret < 0) {
        ret = submit_ret;
    } else {
        k_sem_take(&ctx.done, K_FOREVER);
        ret = ctx.ret;
    }
    resp_data->status_code = ret;
    return ret;
}
```

## src/imu.h
```c
#ifndef MBFW_IMU_H
#define MBFW_IMU_H


#include "ICM20948_driver_interface.h"

#include <inttypes.h>

uint8_t imu_sensor_get_status();

int imu_sensor_init();

int imu_sensor_start(int sample_iter, uint16_t acc_fsr, uint16_t gyr_fsr, uint16_t datarate);

int imu_sensor_stop();

int cmd_start_imu(uint8_t* data);

int cmd_stop_imu(uint8_t* data);

#endif //MBFW_IMU_H
```

## src/midge_protocol.h
```c
#ifndef MB_PROTOCOL_H
#define MB_PROTOCOL_H

#include <inttypes.h>


// ==== Miscellaneous data types ===== //
union __attribute__((packed)) BadgeAssignment {
    struct __attribute__((packed)) {
        uint16_t group : 4;
        uint16_t badge : 12;
    } badge_id; // little endian assumed
    uint16_t u16_all;
};

struct __attribute__((packed)) CustomAdvertisementData {
    uint16_t battery_mv;
    uint16_t active_sensor_bitflags;
    union BadgeAssignment badge_assignment;
};

// ==== Protocol messages =========== //
struct __attribute__((packed)) CmdSetupExperimentRequest{
  union BadgeAssignment badge_assignment;
  uint16_t experiment_id;
};

struct __attribute__((packed)) CmdSetupExperimentResponse{
  uint8_t status_code;
};

// uint16_t configured_datarate

struct __attribute__((packed)) CmdStatusRequest{
  uint64_t  millis_since_epoch;
};
struct __attribute__((packed)) CmdStatusResponse{
  uint8_t sync_status;
  uint8_t storage_init_status;
  uint8_t audio_init_status;
  uint8_t proximity_init_status;
  int16_t battery_millivolts;
  union BadgeAssignment badge_assignment;
  uint64_t sync_delta_ms;
};

struct __attribute__((packed)) CmdGetFWVersionRequest{
  uint16_t  reserved;
};

struct __attribute__((packed)) CmdGetFWVersionResponse{
  uint8_t version_str[32];
};

struct __attribute__((packed)) CmdStartMicRequest{
  uint16_t sample_id;
  uint8_t mode; // See @ref audio.h for mode definitions
};

struct __attribute__((packed)) CmdStartMicResponse{
  int32_t status_code;
};

struct __attribute__((packed)) CmdStopMicRequest{
  uint16_t  reserved;
};

struct __attribute__((packed)) CmdStopMicResponse{
  int32_t status_code;
};

struct __attribute__((packed)) CmdStartScanRequest{
  uint16_t sample_id;
  uint16_t window;
  uint16_t interval;
  uint16_t reserved;
};

struct __attribute__((packed)) CmdStartScanResponse{
  int32_t status_code;
};

struct __attribute__((packed)) CmdStopScanRequest{
  uint16_t  reserved;
};

struct __attribute__((packed)) CmdStopScanResponse{
  int32_t status_code;
};

struct __attribute__((packed)) CmdEraseSDRequest{
  uint16_t  reserved;
};

struct __attribute__((packed)) CmdEraseSDResponse{
  int32_t status_code;
};

struct __attribute__((packed)) CmdStartIMURequest{
  uint16_t sample_id;
  uint16_t acc_fsr;
  uint16_t gyr_fsr;
  uint16_t datarate;
};

struct __attribute__((packed)) CmdStartIMUResponse{
  int32_t status_code;
};

struct __attribute__((packed)) CmdStopIMURequest{
  uint16_t reserved;
};

struct __attribute__((packed)) CmdStopIMUResponse{
  int32_t status_code;
};

#endif
```

## src/privacy_switch.c
```c
#include "privacy_switch.h"

#include <inttypes.h>
#include <stdbool.h>
#include <zephyr/drivers/gpio.h>
#include <zephyr/kernel.h>
#include <zephyr/logging/log.h>
#include <zephyr/sys/util.h>

#include "audio.h"

LOG_MODULE_REGISTER(privacy_switch);

static const struct gpio_dt_spec sw_off = GPIO_DT_SPEC_GET(DT_ALIAS(sw_audio_off), gpios);
static const struct gpio_dt_spec sw_low = GPIO_DT_SPEC_GET(DT_ALIAS(sw_audio_low), gpios);
static const struct gpio_dt_spec sw_high = GPIO_DT_SPEC_GET(DT_ALIAS(sw_audio_high), gpios);

static struct gpio_callback sw_callback_data;

K_MUTEX_DEFINE(switch_mutex);

bool debouncing = false;
enum privacy_sw_pos sw_pos = PRIVACY_SWITCH_POS_OFF;

void update_privacy_sw_pos() {
    int off = gpio_pin_get(sw_off.port, sw_off.pin);
    int low = gpio_pin_get(sw_low.port, sw_low.pin);
    int high = gpio_pin_get(sw_high.port, sw_high.pin);
    audio_sensor_stop();
    LOG_INF("current switch state: off:%d low:%d hi:%d", off, low, high);

    if (off == 1) {
        sw_pos = PRIVACY_SWITCH_POS_OFF;
    } else if (low == 1) {
        sw_pos = PRIVACY_SWITCH_POS_LOW;
    } else if (high == 1) {
        sw_pos = PRIVACY_SWITCH_POS_HIGH;
    } else {
        // no change but weird, log it
        LOG_INF("no position change!");
    }
}

struct k_work_delayable switch_read_work;
void switch_read_work_handler(struct k_work* work) {
    if (k_mutex_lock(&switch_mutex, K_NO_WAIT) == 0) {
        update_privacy_sw_pos();
        debouncing = false;
        k_mutex_unlock(&switch_mutex);
    }
}

void sw_pos_changed(const struct device* dev, struct gpio_callback* cb, uint32_t pins) {
    if (k_mutex_lock(&switch_mutex, K_NO_WAIT) == 0) {
        if (!debouncing) {
            debouncing = true;
        }
        memset(&switch_read_work, 0, sizeof(switch_read_work));
        k_work_init_delayable(&switch_read_work, switch_read_work_handler);
        k_work_schedule(&switch_read_work, K_MSEC(200));
        k_mutex_unlock(&switch_mutex);
    }
}

int switch_sensor_init() {
    bool gpios_ready =
        gpio_is_ready_dt(&sw_off) || gpio_is_ready_dt(&sw_low) || gpio_is_ready_dt(&sw_high);

    bool gpios_config_done = (gpio_pin_configure_dt(&sw_off, GPIO_INPUT) == 0) &&
                             (gpio_pin_configure_dt(&sw_low, GPIO_INPUT) == 0) &&
                             (gpio_pin_configure_dt(&sw_high, GPIO_INPUT) == 0);

    bool gpios_irq_config_success =
        (gpio_pin_interrupt_configure_dt(&sw_off, GPIO_INT_EDGE_TO_ACTIVE) == 0) &&
        (gpio_pin_interrupt_configure_dt(&sw_low, GPIO_INT_EDGE_TO_ACTIVE) == 0) &&
        (gpio_pin_interrupt_configure_dt(&sw_high, GPIO_INT_EDGE_TO_ACTIVE) == 0);

    gpio_init_callback(&sw_callback_data, sw_pos_changed,
                       BIT(sw_off.pin) | BIT(sw_low.pin) | BIT(sw_high.pin));
    int add_callback_success = gpio_add_callback(sw_off.port, &sw_callback_data);  // assume the same port

    if (!gpios_ready || !gpios_config_done || !gpios_irq_config_success || (add_callback_success!=0)) {
        LOG_ERR("Error: Failed during GPIO initialization");
        return -ENXIO;
    }
    update_privacy_sw_pos();
    return 0;
}

enum privacy_sw_pos switch_sensor_position() { return sw_pos; }
```

## src/privacy_switch.h
```c
#ifndef MB_SWITCH_H
#define MB_SWITCH_H

enum privacy_sw_pos {
    PRIVACY_SWITCH_POS_OFF,
    PRIVACY_SWITCH_POS_LOW,
    PRIVACY_SWITCH_POS_HIGH,
};

int switch_sensor_init();

enum privacy_sw_pos switch_sensor_position();

#endif
```
